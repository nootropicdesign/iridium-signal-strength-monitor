#include <Arduino.h>   // required before wiring_private.h
#include "wiring_private.h" // pinPeripheral() function
#include <IridiumSBD.h>
#include <Adafruit_GPS.h>
#include <Adafruit_ZeroTimer.h>
#include <Adafruit_GFX.h>
#include <Adafruit_SSD1306.h>

#define DIAGNOSTICS true // Change this to see diagnostics
#define GPS_FIX_REQUIRED false
#define POT_PIN A2
#define BUTTON1_PIN 2
#define BUTTON2_PIN 12
#define LED_RED_PIN 5
#define LED_BLUE_PIN 6
#define LED_GREEN_PIN 7
#define SerialMon SerialUSB

void log(const char *s, boolean newline=true);
void log(int n, boolean newline=true);
char buf[32];


boolean modemInitialized = false;

// RX = D11 = PA16
// TX = D10 = PA18
// pads 0, 2 on SERCOM (SERCOM1)
Uart Serial2 (&sercom1, 11, 10, SERCOM_RX_PAD_0, UART_TX_PAD_2);
IridiumSBD modem(Serial2);

void SERCOM1_Handler() {
  Serial2.IrqHandler();
}

// RX = D3 = PA09
// TX = D4 = PA08
// pads 1, 0 on SERCOM_ALT (SERCOM2)
Uart Serial3 (&sercom2, 3, 4, SERCOM_RX_PAD_1, UART_TX_PAD_0);
Adafruit_GPS GPS(&Serial3);
Adafruit_SSD1306 display(-1);
static const unsigned char nootropicdesign_logo [] = {
    0x00, 0x00, 0x00, 0x00, 0x00, 0x00, 0x00, 0x00, 0x00, 0x00, 0x00, 0x00, 0x00, 0x00, 0x00, 0x00,
    0x00, 0x00, 0x00, 0x00, 0x00, 0x00, 0x00, 0x00, 0x00, 0x00, 0x00, 0x00, 0x00, 0x06, 0x00, 0x00,
    0x00, 0x00, 0x00, 0x00, 0x00, 0x00, 0x00, 0x00, 0x00, 0x00, 0x00, 0x00, 0x00, 0x00, 0x00, 0x00,
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    0x00, 0x00, 0x00, 0x00, 0x00, 0x00, 0x00, 0x00, 0x00, 0x00, 0x00, 0x00, 0x00, 0x00, 0x00, 0x00
};

void SERCOM2_Handler() {
  Serial3.IrqHandler();
}

Adafruit_ZeroTimer gpsReadTimer = Adafruit_ZeroTimer(4);

int getMemory();

boolean gpsFix = false;
boolean gpsFixOutput = true;

// current GPS timestamp and position
uint8_t year = 0;
uint8_t month = 0;
uint8_t day = 0;
uint8_t hour = 0;
uint8_t minute = 0;
uint8_t seconds = 0;
int32_t lat = 0;
int32_t lon = 0;

int signalQuality = -1;
int err;

boolean initSatModem() {

  // Begin satellite modem operation
  log("  starting modem...", false);
  err = modem.begin();
  if (err != ISBD_SUCCESS) {
    log("");
    digitalWrite(LED_RED_PIN, HIGH);
    log("  error=", false);
    log(err);
    if (err == ISBD_NO_MODEM_DETECTED) {
      log("  no modem detected");
    }
    return false;
  }
  log("OK");

  // Example: Print the firmware revision
  char version[12];
  log("  fw version=", false);
  err = modem.getFirmwareVersion(version, sizeof(version));
  if (err != ISBD_SUCCESS) {
    log("");
    log("  error=");
    log(err);
    digitalWrite(LED_RED_PIN, HIGH);
    return false;
  }
  log(version);
  // Example: Test the signal quality.
  // This returns a number between 0 and 5.
  // 2 or better is preferred.
  log("  signal quality=", false);
  err = modem.getSignalQuality(signalQuality);
  if (err != ISBD_SUCCESS)
  {
    log("");
    log("  error=");
    log(err);
    digitalWrite(LED_RED_PIN, HIGH);
    return false;
  }
  log(signalQuality);
  modemInitialized = true;
  return true;
}

void initGPS() {
  GPS.begin(9600);

  // Assign pins 2 & 3 ALT_SERCOM functionality
  pinPeripheral(3, PIO_SERCOM_ALT);
  pinPeripheral(4, PIO_SERCOM_ALT);
  delay(200);

  GPS.sendCommand(PMTK_SET_NMEA_OUTPUT_RMCONLY);
  GPS.sendCommand(PMTK_SET_NMEA_UPDATE_1HZ);
  GPS.sendCommand(PMTK_API_SET_FIX_CTL_1HZ);
}

void TC4_Handler() {
  Adafruit_ZeroTimer::timerHandler(4);
}

// Interrupt is called once a millisecond, looks for any new GPS data, and stores it
void gpsReadCallback() {
  GPS.read();
}

void setup() {
  pinMode(BUTTON1_PIN, INPUT_PULLUP);
  pinMode(BUTTON2_PIN, INPUT_PULLUP);
  pinMode(LED_BUILTIN, OUTPUT);
  pinMode(LED_RED_PIN, OUTPUT);
  pinMode(LED_BLUE_PIN, OUTPUT);
  pinMode(LED_GREEN_PIN, OUTPUT);
  digitalWrite(LED_BUILTIN, LOW);
  digitalWrite(LED_RED_PIN, LOW);
  digitalWrite(LED_BLUE_PIN, LOW);
  digitalWrite(LED_GREEN_PIN, LOW);

  Serial1.begin(115200);

  display.begin(SSD1306_SWITCHCAPVCC, 0x3C, false);
  display.clearDisplay();
  display.setTextSize(1);
  display.setTextColor(WHITE);
  display.drawBitmap(0, 15, nootropicdesign_logo, 128, 32, WHITE);
  display.display(); delay(1);
  delay(1000);

  // animation
  int mid = 30;
  display.drawLine(0, mid, display.width()-1, mid, BLACK);
  display.display(); delay(1);
  for(int y=1;y<=mid;y++) {
    display.drawLine(0, mid-y, display.width()-1, mid-y, BLACK);
    display.drawLine(0, mid+y, display.width()-1, mid+y, BLACK);
    display.display(); delay(1);
  }

  display.clearDisplay();
  display.setCursor(0, 0);
  display.display(); delay(1);

  log("init GPS...", false);
  initGPS();
  log("OK");

  gpsReadTimer.configure(TC_CLOCK_PRESCALER_DIV64, TC_COUNTER_SIZE_16BIT, TC_WAVE_GENERATION_MATCH_FREQ);
  int ticks_per_ms = F_CPU / 64 / 1000;
  gpsReadTimer.setCompare(0, ticks_per_ms-1);
  gpsReadTimer.setCallback(true, TC_CALLBACK_CC_CHANNEL0, gpsReadCallback);
  gpsReadTimer.enable(true);


  // Start the serial port connected to the satellite modem
  Serial2.begin(19200);
  // Assign pins 10 & 11 SERCOM functionality
  pinPeripheral(11, PIO_SERCOM);
  pinPeripheral(10, PIO_SERCOM);
  log("init satellite modem");
  boolean success = initSatModem();
  if (!success) {
    for(;;);
  }

  delay(2000);
  processGPS();
  if (gpsFix) {
    log("GPS fix acquired");
  } else {
    log("No GPS fix");
  }

  log("READY");
  gpsFixOutput = true;

  for(int i=0;i<3;i++) {
    digitalWrite(LED_BUILTIN, HIGH);
    digitalWrite(LED_GREEN_PIN, HIGH);
    delay(50);
    digitalWrite(LED_BUILTIN, LOW);
    digitalWrite(LED_GREEN_PIN, LOW);
    delay(50);
  }

}

void processGPS() {
  if (GPS.newNMEAreceived()) {
    if (GPS.parse(GPS.lastNMEA())) {
      if (GPS.fix) {
        year = GPS.year;
        month = GPS.month;
        day = GPS.day;
        hour = GPS.hour;
        minute = GPS.minute;
        seconds = GPS.seconds;

        lat = GPS.latitude_fixed;
        if (GPS.lat == 'S') lat *= -1;
        lon = GPS.longitude_fixed;
        if (GPS.lon == 'W') lon *= -1;
      }
    }
  }

  if (gpsFixOutput) {
    if ((!gpsFix) && (GPS.fix)) {
      log("GPS fix acquired");
    }
    if ((gpsFix) && (!GPS.fix)) {
      log("GPS fix lost");
    }
  }
  gpsFix = GPS.fix;
}


void loop() {
  delay(5000);

  err = modem.getSignalQuality(signalQuality);
  if (err != ISBD_SUCCESS) {
    log("");
    log("  error=");
    log(err);
    digitalWrite(LED_RED_PIN, HIGH);
  }
  log("signal quality=", false);
  log(signalQuality);

  processGPS();
  Serial1.print("iridium:");  // prefix with topic:
  Serial1.print("{\"signalQuality\":");
  Serial1.print(signalQuality);
  if (gpsFix) {
    sprintf(buf, "20%2d-%2d-%2dT%02d:%02d:%02dZ", year, month, day, hour, minute, seconds);
    Serial1.print(", \"timestamp\":\"");
    Serial1.print(buf);
    Serial1.print("\"");
  }
  Serial1.println("}");
}

bool ISBDCallback() {
  return true;
}


void log(const char *s, boolean newline) {
  SerialMon.print(s);
  if (newline) {
    SerialMon.println();
  }
  if (display.getCursorY() > 58) {
    display.clearDisplay();
    display.setCursor(0, 0);
  }
  display.print(s);
  if (newline) {
    display.println();
  }
  display.display(); delay(1);
}

void log(int n, boolean newline) {
  char s[8];
  sprintf(s, "%d", n);
  log(s, newline);
}

#if DIAGNOSTICS

void ISBDConsoleCallback(IridiumSBD *device, char c)
{
  SerialMon.write(c);
}

void ISBDDiagsCallback(IridiumSBD *device, char c)
{
  SerialMon.write(c);
}

#endif
